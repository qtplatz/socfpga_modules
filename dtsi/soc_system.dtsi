/*
 * This devicetree is generated by sopc2dts version rel_14.0_RC3-44-g97a55b1-dirty on Tue Sep 22 08:30:25 JST 2020
 * Sopc2dts is written by Walter Goossens <waltergoossens@home.nl>
 * in cooperation with the nios2 community <nios2-dev@lists.rocketboards.org>
 */
/dts-v1/;
/plugin/;
/ {
	//model = "Altera SOCFPGA Cyclone V";	/* appended from boardinfo */
	//compatible = "altr,socfpga-cyclone5", "altr,socfpga";	/* appended from boardinfo */
        // targget-path = "/soc";
	fragment@0 {
		targget-path = "/soc";

		__overlay__ {
			sopc0: sopc@0 {
				device_type = "soc";
				ranges;
				#address-cells = <1>;
				#size-cells = <1>;
				compatible = "ALTR,avalon", "simple-bus";
				bus-frequency = <0>;

				hps_0_bridges: bridge@c0000000 {
					compatible = "altr,bridge-20.1", "simple-bus";
					reg = <0xc0000000 0x20000000>,
					<0xff200000 0x00200000>;
					reg-names = "axi_h2f", "axi_h2f_lw";
					#address-cells = <2>;
					#size-cells = <1>;
					ranges = <0x00000000 0x00000000 0xc0000000 0x00010000>,
					<0x00000001 0x00020000 0xff220000 0x00000008>,
					<0x00000001 0x00010000 0xff210000 0x00000008>,
					<0x00000001 0x00010040 0xff210040 0x00000010>,
					<0x00000001 0x00010080 0xff210080 0x00000010>,
					<0x00000001 0x000100c0 0xff2100c0 0x00000010>,
					<0x00000001 0x00001000 0xff201000 0x00000010>,
					<0x00000001 0x00001100 0xff201100 0x00000010>;

					sysid_qsys: sysid@100010000 {
						compatible = "altr,sysid-20.1", "altr,sysid-1.0";
						reg = <0x00000001 0x00010000 0x00000008>;
						id = <2899645186>;	/* embeddedsw.dts.params.id type NUMBER */
						timestamp = <1626932203>;	/* embeddedsw.dts.params.timestamp type NUMBER */
					}; //end sysid@100010000 (sysid_qsys)

					led_pio: gpio@100010040 {
						compatible = "altr,pio-20.1", "altr,pio-1.0";
						reg = <0x00000001 0x00010040 0x00000010>;
						altr,gpio-bank-width = <8>;	/* embeddedsw.dts.params.altr,gpio-bank-width type NUMBER */
						resetvalue = <0>;	/* embeddedsw.dts.params.resetvalue type NUMBER */
						#gpio-cells = <2>;
						gpio-controller;
						label = "led_pio";	/* appended from boardinfo */
						gpios = <480 2>;	/* appended from boardinfo */
					}; //end gpio@100010040 (led_pio)

					hps_0_arm_gic_0: intc@fffed000 {
						compatible = "arm,cortex-a9-gic-20.1", "arm,cortex-a9-gic";
						reg = <0xfffed000 0x00001000>,
						<0xfffec100 0x00000100>;
						reg-names = "axi_slave0", "axi_slave1";
						interrupt-controller;
						#interrupt-cells = <3>;
					}; //end intc@fffed000 (hps_0_arm_gic_0)

					dipsw_pio: gpio@100010080 {
						compatible = "altr,pio-20.1", "altr,pio-1.0";
						reg = <0x00000001 0x00010080 0x00000010>;
						interrupt-parent = <&hps_0_arm_gic_0>;
						interrupts = <0 40 1>;
						altr,gpio-bank-width = <4>;	/* embeddedsw.dts.params.altr,gpio-bank-width type NUMBER */
						altr,interrupt-type = <3>;	/* embeddedsw.dts.params.altr,interrupt-type type NUMBER */
						altr,interrupt_type = <3>;	/* embeddedsw.dts.params.altr,interrupt_type type NUMBER */
						edge_type = <2>;	/* embeddedsw.dts.params.edge_type type NUMBER */
						level_trigger = <0>;	/* embeddedsw.dts.params.level_trigger type NUMBER */
						resetvalue = <0>;	/* embeddedsw.dts.params.resetvalue type NUMBER */
						#gpio-cells = <2>;
						gpio-controller;
						label = "dipsw_pio";	/* appended from boardinfo */
						gpios = <448 4>;	/* appended from boardinfo */
					}; //end gpio@100010080 (dipsw_pio)

					button_pio: gpio@1000100c0 {
						compatible = "altr,pio-20.1", "altr,pio-1.0";
						reg = <0x00000001 0x000100c0 0x00000010>;
						interrupt-parent = <&hps_0_arm_gic_0>;
						interrupts = <0 41 1>;
						altr,gpio-bank-width = <4>;	/* embeddedsw.dts.params.altr,gpio-bank-width type NUMBER */
						altr,interrupt-type = <2>;	/* embeddedsw.dts.params.altr,interrupt-type type NUMBER */
						altr,interrupt_type = <2>;	/* embeddedsw.dts.params.altr,interrupt_type type NUMBER */
						edge_type = <1>;	/* embeddedsw.dts.params.edge_type type NUMBER */
						level_trigger = <0>;	/* embeddedsw.dts.params.level_trigger type NUMBER */
						resetvalue = <0>;	/* embeddedsw.dts.params.resetvalue type NUMBER */
						#gpio-cells = <2>;
						gpio-controller;
						label = "button_pio";	/* appended from boardinfo */
						gpios = <416 2>;	/* appended from boardinfo */
					}; //end gpio@1000100c0 (button_pio)

					pio_0: gpio@100001000 {
						compatible = "altr,pio-20.1", "altr,pio-1.0";
						reg = <0x00000001 0x00001000 0x00000010>;
						altr,gpio-bank-width = <8>;	/* embeddedsw.dts.params.altr,gpio-bank-width type NUMBER */
						resetvalue = <0>;	/* embeddedsw.dts.params.resetvalue type NUMBER */
						#gpio-cells = <2>;
						gpio-controller;
					}; //end gpio@100001000 (pio_0)

					pio_1: gpio@100001100 {
						compatible = "altr,pio-20.1", "altr,pio-1.0";
						reg = <0x00000001 0x00001100 0x00000010>;
						interrupt-parent = <&hps_0_arm_gic_0>;
						interrupts = <0 43 1>;
						altr,gpio-bank-width = <8>;	/* embeddedsw.dts.params.altr,gpio-bank-width type NUMBER */
						altr,interrupt-type = <1>;	/* embeddedsw.dts.params.altr,interrupt-type type NUMBER */
						altr,interrupt_type = <1>;	/* embeddedsw.dts.params.altr,interrupt_type type NUMBER */
						edge_type = <0>;	/* embeddedsw.dts.params.edge_type type NUMBER */
						level_trigger = <0>;	/* embeddedsw.dts.params.level_trigger type NUMBER */
						resetvalue = <0>;	/* embeddedsw.dts.params.resetvalue type NUMBER */
						#gpio-cells = <2>;
						gpio-controller;
					}; //end gpio@100001100 (pio_1)
				}; //end bridge@c0000000 (hps_0_bridges)

			}; //end sopc@0 (sopc0)
		};
	};
};
